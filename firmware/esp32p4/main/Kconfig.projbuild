## firmware/esp32p4/main/Kconfig.projbuild
```kconfig
menu "PuzzleScript Player"

choice PS_BOARD_TARGET
    prompt "Target board"
    default PS_BOARD_P4_NANO
    help
        Select the hardware board target for GPIO, display, and audio pinout.

config PS_BOARD_P4_NANO
    bool "Waveshare ESP32-P4-NANO + external DSI panel"
    help
        P4-NANO devkit with a Raspberry-Pi-style Waveshare DSI panel
        (default: 4.3\" 800x480 capacitive touch).

config PS_BOARD_WAVESHARE_7B
    bool "Waveshare ESP32-P4-WIFI6-Touch-LCD-7B (dev kit)"
    help
        Integrated 7\" MIPI touch panel (1024x600 EK79007) and ES8311 audio.

config PS_BOARD_CARD
    bool "PuzzleScript Card (custom handheld PCB)"
    help
        Card spin 1 pinout from hardware/card/schematic/connectivity.json.

endchoice

config PS_PLAYER_APP
    bool "Boot into interactive player (game library + touch play)"
    default y
    help
        When enabled, the device boots into the touch game player instead of
        the hardware probe or simulation corpus runner.

config PS_SIMULATION_CORPUS_BOOT
    bool "Prefer simulation corpus when CORPUS.NDJ is present"
    default n
    depends on !PS_PLAYER_APP
    help
        If a simulation corpus bundle exists on flash/SD, run it at boot and
        skip the probe/player UI.

endmenu
```

## firmware/esp32p4/sdkconfig.defaults
```kconfig
CONFIG_IDF_TARGET="esp32p4"
CONFIG_ESP32P4_SELECTS_REV_LESS_V3=y
CONFIG_ESP32P4_REV_MIN_1=y
CONFIG_ESPTOOLPY_FLASHMODE_QIO=y
CONFIG_ESPTOOLPY_FLASHSIZE_16MB=y
CONFIG_PARTITION_TABLE_OFFSET=0x9000
CONFIG_ESP_DEFAULT_CPU_FREQ_MHZ_360=y
CONFIG_PARTITION_TABLE_CUSTOM=y
CONFIG_PARTITION_TABLE_CUSTOM_FILENAME="partitions.csv"
CONFIG_COMPILER_OPTIMIZATION_PERF=y
CONFIG_COMPILER_CXX_EXCEPTIONS=y
CONFIG_COMPILER_CXX_RTTI=y
CONFIG_COMPILER_ORPHAN_SECTIONS_PLACE=y
CONFIG_SPIRAM=y
CONFIG_SPIRAM_SPEED_200M=y
CONFIG_SPIRAM_USE_MALLOC=y
CONFIG_SPIRAM_MALLOC_ALWAYSINTERNAL=16384
CONFIG_PS_BOARD_P4_NANO=y
CONFIG_PS_PLAYER_APP=y
CONFIG_CACHE_L2_CACHE_256KB=y
CONFIG_CACHE_L2_CACHE_LINE_128B=y
CONFIG_ESP_MAIN_TASK_STACK_SIZE=16384
CONFIG_FREERTOS_HZ=1000
CONFIG_FREERTOS_VTASKLIST_INCLUDE_COREID=y
CONFIG_FREERTOS_GENERATE_RUN_TIME_STATS=y
CONFIG_FATFS_VFS_FSTAT_BLKSIZE=4096
CONFIG_FATFS_LFN_HEAP=y
CONFIG_IDF_EXPERIMENTAL_FEATURES=y
```

## firmware/pocket_card/main/Kconfig.projbuild
```kconfig
menu "PuzzleScript Pocket Card"

choice POCKET_CARD_APP_MODE
    prompt "Application mode"
    default POCKET_CARD_PLAYER_APP

config POCKET_CARD_MCP23017_BENCH
    bool "MCP23017 breadboard bench test"
    help
        Scan I2C and print MCP23017 button transitions on the serial console.

config POCKET_CARD_RUNTIME_PROBE
    bool "Track 0 runtime probe"
    help
        Load the embedded IR fixture and run the automated runtime smoke trace.

config POCKET_CARD_PLAYER_APP
    bool "Interactive player (display + MCP23017 controls)"
    help
        Boot into the Pocket Card player with ILI9341 rendering and physical buttons.

endchoice

endmenu
```
